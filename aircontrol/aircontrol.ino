// Load Wi-Fi library
#include <Arduino.h>
#include <ESP8266WiFi.h>
#include <IRremoteESP8266.h>
#include <IRsend.h>

// 본인이 사용하는 공유기의 ssid와 psaaword로 설정 하여야 한다.
#ifndef STA_SSID
#define STA_SSID      "공유기 ID"
#define STA_PASSWORD  "공유기 PASSWORD"
#endif

#define BAUD_SERIAL 115200
#define BAUD_LOGGER 115200
// Message logging Serial Port(UART0와 UART1 중에서 선택)을 설정 한다.
// UART0를 Microcontroller 와 Serial 통신에 사용하는 경우 UART1을 Logger로 사용 한다.
// ESP8266 NodeMCU 보드에는 TxD1(GPIO2) Pin 만 있기 때문에 UART1에는 출력만 가능 하다.
#define logger (&Serial)

const char* ssid     = STA_SSID;
const char* password = STA_PASSWORD;

int command = 0;  // 문자열 파싱 값

const uint16_t kIrLed = 4;  // ESP8266 GPIO pin to use. Recommended: 4 (D2).

String myLocalIP;

IRsend irsend(kIrLed);  // Set the GPIO to be used to sending the message.

// Web server port 번호를 80 번으로 한다.
WiFiServer server(80);


// LG 에어컨 코드
uint16_t rawDataLGOn[60] ={
   3069, 9975, 445, 1659, 424, 645, 399, 636, 
   399, 637, 398, 1643, 428, 637, 398, 637, 
   398, 645, 399, 644, 399, 637, 398, 645, 
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   394, 642, 393, 1000};

uint16_t rawDataLGOff[60] ={
   3175, 9980, 455, 1651, 430, 626, 424, 637, 
   400, 618, 425, 1649, 430, 627, 424, 626, 
   425, 636, 400, 1678, 401, 1660, 426, 644, 
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   393, 1685, 395, 1000};

uint16_t rawDataLGDry[60] ={
   3069, 9983, 400, 1657, 425, 645, 399, 626, 
   424, 637, 399, 1670, 400, 636, 399, 637, 
   398, 637, 398, 645, 398, 637, 399, 618, 
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   420, 643, 393, 1000};

uint16_t rawDataLG23[60] ={
   3092, 9954, 428, 1645, 446, 619, 424, 636, 
   399, 645, 399, 1631, 447, 636, 399, 637, 
   399, 636, 399, 637, 398, 637, 399, 619, 
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   395, 641, 394, 1000};

uint16_t rawDataLG24[60] ={
   3066, 9953, 429, 1644, 447, 619, 424, 637, 
   398, 645, 399, 1632, 447, 636, 399, 636, 
   399, 637, 398, 637, 399, 637, 399, 618, 
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   394, 1677, 394, 1000};

uint16_t rawDataLG25[60] ={
   3095, 9953, 428, 1667, 425, 619, 424, 636, 
   399, 645, 399, 1631, 447, 637, 398, 637, 
   399, 636, 399, 637, 399, 637, 398, 619, 
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   394, 642, 393, 1000};

// Samsung 에어컨 코드
uint16_t rawDataSOn[234] ={
  404, 616, 379, 642, 354, 1612, 378, 1612, 
  404, 1586, 404, 1586, 405, 3092, 2879, 9084, 
  380, 1610, 380, 615, 380, 591, 404, 590, 
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  379, 1000};

uint16_t rawDataSOff[234] ={
  404, 616, 379, 642, 354, 1612, 378, 1612, 
  404, 1586, 404, 1586, 405, 3092, 2879, 9084, 
  380, 1610, 380, 615, 380, 591, 404, 590, 
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  379, 1000};

uint16_t rawDataSDry[234] ={
  404, 616, 379, 642, 354, 1612, 378, 1612, 
  404, 1586, 404, 1586, 405, 3092, 2879, 9084, 
  380, 1610, 380, 615, 380, 591, 404, 590, 
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  379, 1000};

uint16_t rawDataS23[234] ={
  498, 18016, 2913, 9054, 408, 615, 380, 1582, 
  408, 615, 380, 615, 379, 616, 380, 614, 
  381, 614, 381, 615, 380, 591, 404, 1584, 
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  379, 1000};

uint16_t rawDataS24[130] ={
  404, 616, 379, 642, 354, 1612, 378, 1612, 
  404, 1586, 404, 1586, 405, 3092, 2879, 9084, 
  380, 1610, 380, 615, 380, 591, 404, 590, 
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  379, 1000};

uint16_t rawDataS25[234] ={
  498, 18007, 2887, 9053, 411, 587, 407, 1581, 
  408, 641, 353, 642, 353, 642, 378, 617, 
  378, 617, 379, 616, 380, 615, 381, 1584, 
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  379, 1000};

// Carrier 에어컨 제어 코드
uint16_t rawDataCOn[234] ={
  4321, 4511, 456, 1699, 456, 625, 452, 1699, 
457, 1699, 457, 649, 428, 649, 429, 1699, 
457, 649, 428, 650, 428, 1699, 457, 649, 
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447, 1709, 446, 1709, 447, 1709, 447, 1000};

uint16_t rawDataCOff[234] ={
  4323, 4538, 429, 1726, 429, 650, 428, 1726, 
430, 1726, 429, 650, 428, 650, 428, 1725, 
430, 650, 428, 649, 428, 1699, 457, 649, 
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421, 1735, 421, 1735, 421, 1735, 421, 1000};

uint16_t rawDataCDry[234] ={
  4325, 4510, 456, 1696, 459, 650, 428, 1697, 
458, 1726, 429, 650, 428, 650, 428, 1726, 
429, 650, 428, 649, 428, 1726, 429, 650, 
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422, 656, 421, 1735, 421, 1734, 421, 1000};

uint16_t rawDataC23[234] ={
  4322, 4511, 455, 1700, 456, 624, 453, 1699, 
457, 1699, 457, 649, 429, 649, 428, 1699, 
457, 649, 428, 650, 428, 1699, 456, 650, 
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447, 1709, 446, 1710, 446, 1709, 446, 1000};

uint16_t rawDataC24[234] ={
  4320, 4511, 456, 1699, 456, 624, 454, 1699, 
456, 1699, 457, 650, 428, 649, 428, 1699, 
457, 650, 428, 649, 429, 1698, 457, 649, 
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446, 1709, 446, 1709, 447, 1714, 441, 1000};

uint16_t rawDataC25[234] ={
  4372, 4459, 508, 1648, 480, 626, 451, 1675, 
481, 1675, 480, 625, 453, 625, 479, 1649, 
507, 598, 479, 599, 452, 1678, 478, 625, 
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446, 1710, 446, 1710, 446, 1710, 445, 1000};


unsigned long currentTime = millis();   // 현재 시간을 mSec로 저장하는 변수
unsigned long previousTime = 0;         // 이전 시간을 mSec로 저장하는 변수
// Web request timeout 시간을 mSec 단위로 설정(Example: 2000ms = 2s)한다.
const long timeoutTime = 2000;

void setup() {
  logger->begin(115200);

  logger->println();
  logger->print("Connecting to ");
  logger->println(ssid);
  IPAddress ip(000,000,0,0); // 사용할 IP 주소 (에어컨)
  IPAddress gateway(000,000,0,0); // 게이트웨이 주소
  IPAddress subnet(000,000,000,0); // 서브넷 주소
  WiFi.config(ip, gateway, subnet);
  // SSID 와 password를 사용하여 Wi-Fi network에 연결 한다.
  WiFi.begin(ssid, password);
  // WIFi 연결을 기다린다. 이 동안 Logger에 0.5초 간격으로 . 을 출력 한다.
  while (WiFi.status() != WL_CONNECTED) {
    delay(500);
    logger->print(".");
  }
  // Local IP address를 출력한다. 이 IP address를 이용하여 Web browser에서 Server에 연결한다.
  logger->println("");
  logger->println("WiFi connected.");
  myLocalIP = WiFi.localIP().toString();
  logger->println("");
  logger->println("IP: " + myLocalIP);
  logger->println(WiFi.localIP());
  
  // Web server를 시작 한다.
  server.begin();
  irsend.begin();
}

void loop(){
  // 서버에 연결되어 있고 읽을 수있는 데이터가 있는 클라이언트가 있는 경우 Non zero(Client Pointer)가 Return 된다.
  WiFiClient client = server.available();
  if (client) {
    // 만약 새로운 Client 가 열결되었으면 "New Client." 메세지를 출력한다.
    logger->println("New Client.");
    // Client로 부터 전송되는 String의 현재 Line을 저장하는 변수
    // 이 변수에 저장된 문자 수가 0인 상태에서 '\n' 코드가 전송되는 경우 Client HTTP request의 종료를 표시 한다.
    String currentLine = "";
    String message = "";
    currentTime = millis();
    previousTime = currentTime;
    // Client 가 연결되어 있고 while loop 내의 처리 시간이 timeoutTime 시간 보다 작은 경우 while loop를 계속 한다.
    while (client.connected() && currentTime - previousTime <= timeoutTime) {
      currentTime = millis();         // 현재 시간을 Update 한다.        
      if (client.available()) {       // 만약 Client로 부터 읽을 Data(Byte) 가 있으면,
        char c = client.read();       // Data를 읽어 c에 저장하고,
        logger->write(c);             // Logger(Serial monitor)에 출력 한다.
        message += c;
        if (c == '\n') {
          // currentLine에 입력된 문자 수 가 0인 상태에서 '\n' 코드가 입력되면(두 개의 '\n' Code 가 입력 되면),
          // client HTTP request의 끝을 표시하기 때문에 Response을 Send 한다.
          if (currentLine.length() == 0) {
            // HTTP Header는 항상 Response code(예: HTTP/1.1 200 OK)와 
            // Client 가 무슨 문서가 올 것 인지 알 수 있게 content-type을 보내고 Blank line을 보낸다.
            client.println("HTTP/1.1 200 OK");
            client.println("Content-type:text/html");
            client.println("Connection: close");  // Response 완료되면 후 연결이 Close 된다.
            client.println();

            // 문자열 파싱
            int index1, index2;
            
            index1 = message.indexOf('=');
            index2 = message.indexOf('H', index1+1);
            
            command = message.substring(index1+1,index2-1).toInt();
            message="";
            Serial.println(command);

            // LG 코드
            if ( command == 101 ) {
              irsend.sendRaw(rawDataLGOn, 60, 38); // Pass the buffer, length, optionally frequency
              logger->println("LG On");
              }
              
            else if ( command == 102 ) {
              irsend.sendRaw(rawDataLGOff, 60, 38);
              logger->println("LG Off");
              }

            else if ( command == 103 ) {
              irsend.sendRaw(rawDataLGDry, 60, 38);
              logger->println("LG Dry");
              }

            else if ( command == 123 ) {
              irsend.sendRaw(rawDataLG23, 60, 38);
              logger->println("LG 23c");
              }

            else if ( command == 124 ) {
              irsend.sendRaw(rawDataLG24, 60, 38);
              logger->println("LG 24c");
              }

            else if ( command == 125 ) {
              irsend.sendRaw(rawDataLG25, 60, 38);
              logger->println("LG 25c");
              }

            // Samsung 코드
            else if ( command == 201 ) {
              irsend.sendRaw(rawDataSOn, 234, 38);
              logger->println("Samsung On");
              }
              
            else if ( command == 202 ) {
              irsend.sendRaw(rawDataSOff, 234, 38); 
              logger->println("Samsung Off");
              }

            else if ( command == 203 ) {
              irsend.sendRaw(rawDataSDry, 234, 38); 
              logger->println("Samsung Dry");
              }

            else if ( command == 223 ) {
              irsend.sendRaw(rawDataS23, 234, 38);
              logger->println("Samsung 23c");
              }

            else if ( command == 224 ) {
              irsend.sendRaw(rawDataS24, 130, 38); 
              logger->println("Samsung 24c");
              }

            else if ( command == 225 ) {
              irsend.sendRaw(rawDataS25, 234, 38); 
              logger->println("Samsung 25c");
              }

            // Carrier 코드
            else if ( command == 301 ) {
              irsend.sendRaw(rawDataCOn, 234, 38); 
              logger->println("Carrier On");
              }
              
            else if ( command == 302 ) {
              irsend.sendRaw(rawDataCOff, 234, 38); 
              logger->println("Carrier Off");
              }

            else if ( command == 303 ) {
              irsend.sendRaw(rawDataCDry, 234, 38);
              logger->println("Carrier Dry");
              }

            else if ( command == 323 ) {
              irsend.sendRaw(rawDataC23, 234, 38); 
              logger->println("Carrier 23c");
              }

            else if ( command == 324 ) {
              irsend.sendRaw(rawDataC24, 234, 38); 
              logger->println("Carrier 24c");
              }

            else if ( command == 325 ) {
              irsend.sendRaw(rawDataC25, 234, 38); 
              logger->println("Carrier 25c");
              }
              
            // 버퍼에 남아있는 데이터 삭제
            client.flush();
            // 새로운 Blank line을 전송하여 HTTP response의 종료를 표시한다.
            client.println();
            // while loop를 Break out 한다.
         } else {
          // '/n' (Newline)문자를 받은 경우 currentLine을 Clear(문자 수가 0 이 됨) 한다. client HTTP request의 끝을 판단하는데 이용.
            currentLine = "";
           }

        } else if (c != '\r') {
          // 입력된 문자가 '\r'(carriage return) 문자가 아닌 경우 currentLine의 끝에 문자를 첨부한다.
          currentLine += c;
        }
      }
    }
    // Header variable을 Clear 한다. 
    message = "";
    // Close the connection
    client.stop();
    logger->println("Client disconnected.");
    logger->println("");
  }
}
